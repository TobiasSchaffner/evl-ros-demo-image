## conf/layer.conf
```bitbake
#
# ISAR ROS Xenomai Image
#
# SPDX-License-Identifier: MIT
#

BBPATH .= ":${LAYERDIR}"

BBFILES += "${LAYERDIR}/recipes-*/*/*.bb ${LAYERDIR}/recipes-*/*/*.bbappend"

BBFILE_COLLECTIONS += "isar-ros-xenomai"
BBFILE_PATTERN_isar-ros-xenomai = "^${LAYERDIR}/recipes-"
BBFILE_PRIORITY_isar-ros-xenomai = "7"

LAYERSERIES_COMPAT_isar-ros-xenomai = "next"

LAYERDIR_isar-ros-xenomai = "${LAYERDIR}"

ISAR_RELEASE_CMD = "git -C ${LAYERDIR} describe --all --long --dirty"
```
